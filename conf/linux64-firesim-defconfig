## overlays/keystone/configs/riscv64_mpfs_defconfig
```kconfig
BR2_riscv=y
BR2_riscv_custom=y
BR2_RISCV_ISA_CUSTOM_RVM=y
BR2_RISCV_ISA_CUSTOM_RVF=y
BR2_RISCV_ISA_CUSTOM_RVD=y
BR2_RISCV_ISA_CUSTOM_RVC=y
BR2_KERNEL_HEADERS_VERSION=y
BR2_DEFAULT_KERNEL_VERSION="5.15.30"
BR2_PACKAGE_HOST_LINUX_HEADERS_CUSTOM_5_15=y
BR2_PACKAGE_GLIBC_UTILS=y
BR2_BINUTILS_VERSION_2_37_X=y
BR2_TOOLCHAIN_BUILDROOT_CXX=y
BR2_PACKAGE_HOST_GDB=y
BR2_PACKAGE_HOST_GDB_PYTHON3=y
BR2_CCACHE=y
BR2_GLOBAL_PATCH_DIR="$(BR2_EXTERNAL_KEYSTONE_PATH)/patches $(BR2_EXTERNAL_KEYSTONE_PATH)/board/mpfs/patches"
BR2_PER_PACKAGE_DIRECTORIES=y
BR2_SSP_NONE=y
BR2_ROOTFS_DEVICE_CREATION_DYNAMIC_MDEV=y
BR2_ROOTFS_POST_BUILD_SCRIPT="$(BR2_EXTERNAL_MCHP_PATH)/board/microchip/icicle/post-build.sh $(BR2_EXTERNAL_KEYSTONE_PATH)/board/mpfs/post-build.sh"
BR2_ROOTFS_POST_IMAGE_SCRIPT="$(BR2_EXTERNAL_MCHP_PATH)/board/microchip/icicle/post-image.sh"
BR2_ROOTFS_POST_SCRIPT_ARGS="$(BR2_EXTERNAL_MCHP_PATH)/board/microchip/icicle/genimage_rootfs.cfg"
BR2_LINUX_KERNEL=y
BR2_LINUX_KERNEL_CUSTOM_TARBALL=y
BR2_LINUX_KERNEL_CUSTOM_TARBALL_LOCATION="$(call github,linux4microchip,linux,linux-5.15-mchp+fpga)/linux4microchip+fpga-2023.02.01.tar.gz"
BR2_LINUX_KERNEL_USE_CUSTOM_CONFIG=y
BR2_LINUX_KERNEL_CUSTOM_CONFIG_FILE="$(BR2_EXTERNAL_KEYSTONE_PATH)/configs/linux64-mpfs-defconfig"
BR2_LINUX_KERNEL_DTS_SUPPORT=y
BR2_LINUX_KERNEL_INTREE_DTS_NAME="microchip/mpfs-icicle-kit"
BR2_LINUX_KERNEL_DTB_KEEP_DIRNAME=y
BR2_LINUX_KERNEL_DTB_OVERLAY_SUPPORT=y
BR2_PACKAGE_LINUX_TOOLS_GPIO=y
BR2_PACKAGE_LINUX_TOOLS_IIO=y
BR2_PACKAGE_BUSYBOX_SHOW_OTHERS=y
BR2_PACKAGE_DHRYSTONE=y
BR2_PACKAGE_LMBENCH=y
BR2_PACKAGE_E2FSPROGS=y
BR2_PACKAGE_MTD=y
BR2_PACKAGE_GPTFDISK=y
BR2_PACKAGE_GPTFDISK_GDISK=y
BR2_PACKAGE_GPTFDISK_SGDISK=y
BR2_PACKAGE_I2C_TOOLS=y
BR2_PACKAGE_PCIUTILS=y
BR2_PACKAGE_RNG_TOOLS=y
BR2_PACKAGE_PYTHON3=y
BR2_PACKAGE_PYTHON_FLASK=y
BR2_PACKAGE_CA_CERTIFICATES=y
BR2_PACKAGE_JPEG=y
BR2_PACKAGE_DTC=y
BR2_PACKAGE_DTC_PROGRAMS=y
BR2_PACKAGE_LIBGPIOD=y
BR2_PACKAGE_LIBGPIOD_TOOLS=y
BR2_PACKAGE_LIBIIO=y
BR2_PACKAGE_LIBIIO_BINDINGS_PYTHON=y
BR2_PACKAGE_COLLECTD=y
BR2_PACKAGE_COLLECTD_EXEC=y
BR2_PACKAGE_COLLECTD_CSV=y
BR2_PACKAGE_IPERF=y
BR2_PACKAGE_IPERF3=y
BR2_PACKAGE_NTP=y
BR2_PACKAGE_NTP_NTPDATE=y
BR2_PACKAGE_OPENSSH=y
BR2_PACKAGE_SOCAT=y
BR2_PACKAGE_WGET=y
BR2_PACKAGE_BASH=y
BR2_PACKAGE_SCREEN=y
BR2_PACKAGE_COREUTILS=y
BR2_PACKAGE_COREUTILS_INDIVIDUAL_BINARIES=y
BR2_PACKAGE_HTOP=y
BR2_PACKAGE_TAR=y
BR2_PACKAGE_NANO=y
BR2_TARGET_ROOTFS_EXT2=y
BR2_TARGET_ROOTFS_EXT2_4=y
BR2_TARGET_ROOTFS_EXT2_LABEL="ROOTFS"
BR2_TARGET_ROOTFS_EXT2_SIZE="512M"
# BR2_TARGET_ROOTFS_TAR is not set
BR2_TARGET_UBOOT=y
BR2_TARGET_UBOOT_BUILD_SYSTEM_KCONFIG=y
BR2_TARGET_UBOOT_CUSTOM_GIT=y
BR2_TARGET_UBOOT_CUSTOM_REPO_URL="https://github.com/polarfire-soc/u-boot"
BR2_TARGET_UBOOT_CUSTOM_REPO_VERSION="linux4microchip+fpga-2023.02"
BR2_TARGET_UBOOT_BOARD_DEFCONFIG="microchip_mpfs_icicle"
BR2_TARGET_UBOOT_CONFIG_FRAGMENT_FILES="$(BR2_EXTERNAL_KEYSTONE_PATH)/board/mpfs/uboot-fragment-rootfs.config"
BR2_TARGET_UBOOT_NEEDS_DTC=y
BR2_TARGET_UBOOT_NEEDS_OPENSSL=y
BR2_PACKAGE_HOST_BMAP_TOOLS=y
BR2_PACKAGE_HOST_GENEXT2FS=y
BR2_PACKAGE_HOST_GENIMAGE=y
BR2_PACKAGE_HOST_GPTFDISK=y
BR2_PACKAGE_HOST_MTOOLS=y
BR2_PACKAGE_HOST_SQUASHFS=y
BR2_PACKAGE_HOST_UBOOT_TOOLS=y
BR2_PACKAGE_HOST_UBOOT_TOOLS_FIT_SUPPORT=y
BR2_PACKAGE_HOST_UBOOT_TOOLS_BOOT_SCRIPT=y
BR2_PACKAGE_HOST_UBOOT_TOOLS_BOOT_SCRIPT_SOURCE="$(BR2_EXTERNAL_MCHP_PATH)/board/microchip/icicle/uboot-env.txt"
BR2_PACKAGE_DT_OVERLAY_MCHP=y
BR2_PACKAGE_DT_OVERLAY_MCHP_PLATFORM="mpfs_icicle"
BR2_PACKAGE_MPFS_EXAMPLES=y
BR2_PACKAGE_HOST_HSS_PAYLOAD_GENERATOR=y
BR2_PACKAGE_HOST_HSS_PAYLOAD_GENERATOR_CFG="$(BR2_EXTERNAL_KEYSTONE_PATH)/board/mpfs/hss-config.yaml"
BR2_PACKAGE_HOST_HSS_PAYLOAD_GENERATOR_SRC="$(BINARIES_DIR)/u-boot.bin"
BR2_TARGET_KEYSTONE_SM=y
BR2_TARGET_HSS=y
BR2_PACKAGE_KEYSTONE_DRIVER=y
BR2_PACKAGE_HOST_KEYSTONE_SDK=y
BR2_PACKAGE_KEYSTONE_RUNTIME=y
BR2_PACKAGE_KEYSTONE_EXAMPLES=y
```

## overlays/keystone/configs/riscv64_starfive_visionfive2_defconfig
```kconfig
# Shortened and adjusted VF2 defconfig, normal version is located here:
# https://github.com/starfive-tech/VisionFive2/blob/JH7110_VisionFive2_devel/conf/buildroot_rootfs_config
BR2_riscv=y
BR2_TOOLCHAIN_BUILDROOT_CXX=y
BR2_PACKAGE_GLIBC_UTILS=y
BR2_STRIP_EXCLUDE_FILES="ipa_starfive.so* libcamera-base.so* libcamera.so* libgstlibcamera.so v4l2-compat.so starfive_ipa_proxy"
BR2_BINUTILS_VERSION_2_39_X=y
BR2_GCC_VERSION_11_X=y
BR2_CCACHE=y
BR2_SSP_NONE=y
BR2_CCACHE_INITIAL_SETUP="-M0 -F0"
BR2_GLOBAL_PATCH_DIR="$(BR2_EXTERNAL_KEYSTONE_PATH)/board/starfive/visionfive2/patches"
BR2_PER_PACKAGE_DIRECTORIES=y
BR2_TOOLCHAIN_BUILDROOT_FORTRAN=y
BR2_GCC_ENABLE_LTO=y
BR2_GCC_ENABLE_OPENMP=y
BR2_TOOLCHAIN_GLIBC_GCONV_LIBS_COPY=y
BR2_INIT_SYSV=y
BR2_ROOTFS_DEVICE_CREATION_DYNAMIC_EUDEV=y
BR2_TARGET_GENERIC_HOSTNAME="keystone"
BR2_TARGET_GENERIC_ROOT_PASSWD="starfive"
BR2_SYSTEM_DHCP="end0"
BR2_SYSTEM_DHCP_DUAL="end1"
BR2_INIT_SYSTEMD=y
BR2_SYSTEM_BIN_SH_BASH=y
BR2_ROOTFS_POST_BUILD_SCRIPT="$(BR2_EXTERNAL_KEYSTONE_PATH)/board/starfive/visionfive2/post-build.sh"
BR2_ROOTFS_POST_IMAGE_SCRIPT="support/scripts/genimage.sh"
BR2_ROOTFS_POST_SCRIPT_ARGS="-c $(BR2_EXTERNAL_KEYSTONE_PATH)/board/starfive/visionfive2/genimage_sdcard.cfg"

# Linux kernel configuration
BR2_LINUX_KERNEL=y
BR2_LINUX_KERNEL_CUSTOM_VERSION=y
BR2_LINUX_KERNEL_CUSTOM_VERSION_VALUE="6.7"
BR2_LINUX_KERNEL_USE_CUSTOM_CONFIG=y
BR2_LINUX_KERNEL_CUSTOM_CONFIG_FILE="$(BR2_EXTERNAL_KEYSTONE_PATH)/board/starfive/visionfive2/linux-starfive-visionfive2-defconfig"
BR2_LINUX_KERNEL_DTS_SUPPORT=y
BR2_LINUX_KERNEL_INTREE_DTS_NAME="starfive/jh7110-starfive-visionfive-2-v1.3b"
BR2_LINUX_KERNEL_INSTALL_TARGET=y


# Root filesystem
BR2_TARGET_ROOTFS_EXT2=y
BR2_TARGET_ROOTFS_EXT2_4=y
BR2_TARGET_ROOTFS_EXT2_SIZE="500M"

# U-Boot and OpenSBI configuration
BR2_TARGET_OPENSBI=y
BR2_TARGET_OPENSBI_CUSTOM_GIT=y
BR2_TARGET_OPENSBI_CUSTOM_REPO_URL="https://github.com/starfive-tech/opensbi.git"
BR2_TARGET_OPENSBI_CUSTOM_REPO_VERSION="JH7110_VisionFive2_devel"
BR2_TARGET_OPENSBI_PLAT="generic"
BR2_TARGET_OPENSBI_ADDITIONAL_VARIABLES="FW_TEXT_START=0x40000000"
BR2_TARGET_UBOOT=y
BR2_TARGET_UBOOT_BUILD_SYSTEM_KCONFIG=y
BR2_TARGET_UBOOT_CUSTOM_VERSION=y
BR2_TARGET_UBOOT_CUSTOM_VERSION_VALUE="2024.04"
BR2_TARGET_UBOOT_BOARD_DEFCONFIG="starfive_visionfive2"
BR2_TARGET_UBOOT_NEEDS_DTC=y
BR2_TARGET_UBOOT_NEEDS_PYLIBFDT=y
BR2_TARGET_UBOOT_NEEDS_OPENSBI=y
BR2_TARGET_UBOOT_NEEDS_OPENSSL=y
BR2_TARGET_UBOOT_FORMAT_CUSTOM=y
BR2_TARGET_UBOOT_FORMAT_CUSTOM_NAME="u-boot.itb"
BR2_TARGET_UBOOT_SPL=y
BR2_TARGET_UBOOT_SPL_NAME="spl/u-boot-spl.bin.normal.out"
BR2_PACKAGE_HOST_UBOOT_TOOLS=y
BR2_TARGET_KEYSTONE_SM=y
BR2_PACKAGE_KEYSTONE_DRIVER=y
BR2_PACKAGE_HOST_KEYSTONE_SDK=y
BR2_PACKAGE_KEYSTONE_RUNTIME=y
BR2_PACKAGE_KEYSTONE_EXAMPLES=y

# Packages
BR2_PACKAGE_OPENSSH=y
BR2_PACKAGE_PYTHON3=y
BR2_PACKAGE_PYTHON3_PIP=y
BR2_PACKAGE_APT=y
BR2_PACKAGE_OPKG=y
BR2_PACKAGE_DPKG=y
BR2_PACKAGE_LIBSSL=y
BR2_PACKAGE_LIBCURL=y
BR2_PACKAGE_LIBCURL_CURL=y
BR2_PACKAGE_LIBOPENSSL=y
BR2_PACKAGE_LIBOPENSSL_BIN=y
BR2_PACKAGE_WGET=y
BR2_PACKAGE_NANO=y
BR2_PACKAGE_HOST_GENEXT2FS=y
BR2_PACKAGE_HOST_GENIMAGE=y
BR2_PACKAGE_HOST_GPTFDISK=y
BR2_PACKAGE_HOST_MTOOLS=y
BR2_PACKAGE_HOST_STFISP_SETFILE=y
BR2_PACKAGE_BASH=y
# BR2_PACKAGE_DHCP=y
# BR2_PACKAGE_DHCP_SERVER=y
# BR2_PACKAGE_DHCP_SERVER_DELAYED_ACK=y
BR2_PACKAGE_ETHTOOL=y
BR2_PACKAGE_IPROUTE2=y
BR2_PACKAGE_IPTABLES=y
BR2_PACKAGE_IPTABLES_NFTABLES=y
BR2_PACKAGE_IPUTILS=y
BR2_PACKAGE_LINUX_FIRMWARE=y
BR2_PACKAGE_LINUX_FIRMWARE_IWLWIFI_AX210=y
BR2_PACKAGE_LINUX_FIRMWARE_RTL_8169=y
BR2_PACKAGE_DTC=y
BR2_PACKAGE_DTC_PROGRAMS=y
BR2_PACKAGE_HOST_GDB=y
BR2_PACKAGE_HOST_GDB_TUI=y
BR2_PACKAGE_HOST_GDB_PYTHON3=y
BR2_PACKAGE_HOST_GDB_SIM=y
```

## overlays/keystone/package/keystone-driver/Config.in
```kconfig
config BR2_PACKAGE_KEYSTONE_DRIVER
        bool "Keystone driver"
        depends on BR2_PACKAGE_HOST_KEYSTONE_SDK
        help
          Linux driver for the Keystone TEE system
```

## overlays/keystone/package/keystone-examples/Config.in
```kconfig
config BR2_PACKAGE_KEYSTONE_EXAMPLES
        bool "Keystone examples"
        depends on BR2_PACKAGE_HOST_KEYSTONE_SDK
        depends on BR2_PACKAGE_KEYSTONE_RUNTIME
        select BR2_PACKAGE_MUSL
        help
          Example applications for Keystone, showing a variety
          of functionalities and features
```

## overlays/keystone/package/keystone-runtime/Config.in
```kconfig
config BR2_PACKAGE_KEYSTONE_RUNTIME
        bool "Keystone Eyrie runtime"
        depends on BR2_PACKAGE_HOST_KEYSTONE_SDK
        help
          Eyrie runtime
```

## overlays/keystone/package/keystone-sdk/Config.in.host
```kconfig
config BR2_PACKAGE_HOST_KEYSTONE_SDK
        bool "Keystone SDK"
        help
          SDK for Keystone enclaves
```

## overlays/tvm/Config.in
```kconfig
# Packages
source "$BR2_EXTERNAL_TVM_PATH/package/gcc-target/Config.in"
source "$BR2_EXTERNAL_TVM_PATH/package/python-cloudpickle/Config.in"
source "$BR2_EXTERNAL_TVM_PATH/package/tvm/Config.in"
source "$BR2_EXTERNAL_TVM_PATH/package/tvm/Config.in.host"
source "$BR2_EXTERNAL_TVM_PATH/package/python-tvm/Config.in"
source "$BR2_EXTERNAL_TVM_PATH/package/python-vta/Config.in"
source "$BR2_EXTERNAL_TVM_PATH/package/vta-driver/Config.in"

config BR2_PACKAGE_PYTHON_NUMPY_ARCH_SUPPORTS
	default y if BR2_riscv
```

## overlays/tvm/package/gcc-target/Config.in
```kconfig
config BR2_PACKAGE_GCC_TARGET
	bool "gcc-target"
	depends on BR2_TOOLCHAIN_BUILDROOT
	select BR2_PACKAGE_BINUTILS
	select BR2_PACKAGE_BINUTILS_TARGET
	select BR2_PACKAGE_GMP
	select BR2_PACKAGE_MPFR
	select BR2_PACKAGE_MPC
	help
	  If you want the target system to be able to run
	  binutils/gcc and compile native code, say Y here.

config BR2_EXTRA_TARGET_GCC_CONFIG_OPTIONS
	string "Additional target gcc options"
	default ""
	depends on BR2_PACKAGE_GCC_TARGET
	help
	  Any additional target gcc options you may want to include....
	  Including, but not limited to --disable-checking etc.
	  Refer to */configure in your gcc sources.
```

## overlays/tvm/package/python-cloudpickle/Config.in
```kconfig
config BR2_PACKAGE_PYTHON_CLOUDPICKLE
        bool "python-cloudpickle"
        help
          CloudPickle!
```

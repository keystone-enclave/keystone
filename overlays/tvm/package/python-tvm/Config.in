## overlays/tvm/package/python-tvm/Config.in
```kconfig
config BR2_PACKAGE_PYTHON_TVM
	bool "Python bindings for Apache TVM"
	depends on BR2_PACKAGE_HOST_TVM
	select BR2_PACKAGE_HOST_PYTHON3
	select BR2_PACKAGE_HOST_PYTHON3_SSL
	select BR2_PACKAGE_HOST_PYTHON3_BZIP2
	select BR2_PACKAGE_PYTHON_DECORATOR
	select BR2_PACKAGE_PYTHON_PSUTIL
	select BR2_PACKAGE_PYTHON_TYPING_EXTENSIONS
```

## overlays/tvm/package/python-vta/Config.in
```kconfig
config BR2_PACKAGE_PYTHON_VTA
	bool "Python bindings for Apache TVM"
	depends on BR2_PACKAGE_HOST_TVM
	select BR2_PACKAGE_HOST_PYTHON3
	select BR2_PACKAGE_HOST_PYTHON3_SSL
	select BR2_PACKAGE_HOST_PYTHON3_BZIP2
```

## overlays/tvm/package/tvm/Config.in
```kconfig
config BR2_PACKAGE_TVM
        bool "Apache TVM"

config BR2_PACKAGE_TVM_VTA
	bool "Build support for the VTA hardware accelerator
	depends on BR2_PACKAGE_TVM

config BR2_PACKAGE_TVM_VTA_FAMILY
	string "VTA driver to bundle"
	depends on BR2_PACKAGE_TVM_VTA
```

## overlays/tvm/package/tvm/Config.in.host
```kconfig
config BR2_PACKAGE_HOST_TVM
        bool "Host-side Apache TVM"
#	depends on BR2_PACKAGE_LLVM
```
